## app/boards/arm/e73_840/Kconfig.board
```kconfig
# BlueMicro840 board configuration

# Copyright (c) 2020 Pete Johanson, Derek Schmell
# SPDX-License-Identifier: MIT

config BOARD_E73_840
	bool "E73_840"
	depends on SOC_NRF52840_QIAA
```

## app/boards/arm/nl_10/Kconfig.board
```kconfig
# BlueMicro840 board configuration

# Copyright (c) 2020 Pete Johanson, Derek Schmell
# SPDX-License-Identifier: MIT

config BOARD_NL_10
	bool "NL_10"
	depends on SOC_NRF52840_QIAA
```

## app/boards/arm/nl_10/Kconfig.defconfig
```kconfig
# BlueMicro840 board configuration

# Copyright (c) 2020 Pete Johanson, Derek Schmell
# SPDX-License-Identifier: MIT

if BOARD_NL_10

config BOARD
	default "nl_10"

config ZMK_KEYBOARD_NAME
	default "mechkey_nl10"

if USB

config USB_NRFX
	default y

config USB_DEVICE_STACK
	default y

endif # USB

config BT_CTLR
	default BT

config ZMK_BLE
	default y

config ZMK_USB
	default y

config ZMK_BATTERY_VOLTAGE_DIVIDER
	default y

endif # BOARD_NL_10
```

## app/boards/arm/nl_50/Kconfig.board
```kconfig
# BlueMicro840 board configuration

# Copyright (c) 2020 Pete Johanson, Derek Schmell
# SPDX-License-Identifier: MIT

config BOARD_NL_50
	bool "NL_50"
	depends on SOC_NRF52840_QIAA
```

## app/boards/arm/nl_90/Kconfig.board
```kconfig
# BlueMicro840 board configuration

# Copyright (c) 2020 Pete Johanson, Derek Schmell
# SPDX-License-Identifier: MIT

config BOARD_NL_90
	bool "NL_90"
	depends on SOC_NRF52840_QIAA
```

## app/boards/shields/dualmac/Kconfig.defconfig
```kconfig
# Copyright (c) 2020 The ZMK Contributors
# SPDX-License-Identifier: MIT
 
 
if SHIELD_DUALMAC_LEFT

config ZMK_KEYBOARD_NAME
	default "Dual Macro Left"

config ZMK_SPLIT_BLE_ROLE_CENTRAL
	default y

endif

if SHIELD_DUALMAC_RIGHT

config ZMK_KEYBOARD_NAME
	default "Dual Macro Right"

endif

if SHIELD_DUALMAC_LEFT || SHIELD_DUALMAC_RIGHT

config ZMK_SPLIT
	default y

endif
```

## app/boards/shields/dualmac/Kconfig.shield
```kconfig
# Copyright (c) 2020 The ZMK Contributors
# SPDX-License-Identifier: MIT

config SHIELD_DUALMAC_LEFT
	def_bool $(shields_list_contains,dualmac_left)

config SHIELD_DUALMAC_RIGHT
	def_bool $(shields_list_contains,dualmac_right)
```
