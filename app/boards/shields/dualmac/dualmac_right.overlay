/*
 * Copyright (c) 2020 The ZMK Contributors
 *
 * SPDX-License-Identifier: MIT
 */

#include "dualmac.dtsi"

&default_transform {
    col-offset = <4>;
};

/ {

    /* This kscan is for the 65% right half the 60% right half 
     * may require different column and row pins
     */
    kscan0: kscan {
        compatible = "zmk,kscan-gpio-matrix";
        label = "KSCAN";
        diode-direction = "col2row";



        row-gpios
            = <&gpio0 5  (GPIO_ACTIVE_HIGH | GPIO_PULL_DOWN)>
            , <&gpio1 9  (GPIO_ACTIVE_HIGH | GPIO_PULL_DOWN)>
            , <&gpio1 10 (GPIO_ACTIVE_HIGH | GPIO_PULL_DOWN)>
            ;
		col-gpios
			= <&gpio0 2  GPIO_ACTIVE_HIGH>
			, <&gpio0 31 GPIO_ACTIVE_HIGH>
			, <&gpio0 29 GPIO_ACTIVE_HIGH>
			, <&gpio0 30 GPIO_ACTIVE_HIGH>
			;
    };

	// right_encoder: encoder_right {
	// 	compatible = "alps,ec11";
	// 	label = "RIGHT_ENCODER";
	// 	a-gpios = <&gpio0 24 (GPIO_ACTIVE_LOW | GPIO_PULL_UP)>;
	// 	b-gpios = <&gpio1 11 (GPIO_ACTIVE_LOW | GPIO_PULL_UP)>;
	// 	resolution = <4>;
	// };

	// sensors {
	// 	compatible = "zmk,keymap-sensors";
	// 	sensors = <&right_encoder>;
	// };
};

&right_encoder {
	status = "okay";
};
