/*
 * Copyright (c) 2020 The ZMK Contributors
 *
 * SPDX-License-Identifier: MIT
 */

#include "dualmac.dtsi"

/ {
    /* This kscan is for the 60% left half without macro keys the
     * macro pad layout may require different column and row pins
     */
    kscan0: kscan {
        compatible = "zmk,kscan-gpio-matrix";
        label = "KSCAN";
        diode-direction = "col2row";


     row-gpios
				= <&gpio0 30 (GPIO_ACTIVE_HIGH | GPIO_PULL_DOWN)>
				, <&gpio0 31 (GPIO_ACTIVE_HIGH | GPIO_PULL_DOWN)>
				, <&gpio0 28 (GPIO_ACTIVE_HIGH | GPIO_PULL_DOWN)>
				;
		col-gpios
		    = <&gpio1 2  GPIO_ACTIVE_HIGH>
		    , <&gpio0 8  GPIO_ACTIVE_HIGH>
		    , <&gpio0 4  GPIO_ACTIVE_HIGH>
		    , <&gpio0 7  GPIO_ACTIVE_HIGH>
		    ;
    };

		// left_encoder: encoder_left {
		// 	compatible = "alps,ec11";
		// 	label = "LEFT_ENCODER";
		// 	// a-gpios = <&gpio0 24 (GPIO_ACTIVE_LOW | GPIO_PULL_UP)>;
		// 	// b-gpios = <&gpio1 11 (GPIO_ACTIVE_LOW | GPIO_PULL_UP)>;
		// 	// Handwired
		// 	a-gpios = <&gpio0 6  (GPIO_ACTIVE_LOW | GPIO_PULL_UP)>;
		// 	b-gpios = <&gpio0 22 (GPIO_ACTIVE_LOW | GPIO_PULL_UP)>;
		// 	resolution = <4>;
		// };
	
		// sensors {
		// 	compatible = "zmk,keymap-sensors";
		// 	sensors = <&left_encoder>;
		// };
};

&left_encoder {
	status = "okay";
};
